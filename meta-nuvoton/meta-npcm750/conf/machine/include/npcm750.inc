## meta-nuvoton/meta-npcm750/conf/machine/include/npcm750.inc
```bitbake
#@TYPE: Machine
#@NAME: Nuvoton NPCM750
#@DESCRIPTION: Machine configuration for Nuvoton NPCM750 BMC

require conf/machine/include/tune-nuvoton.inc

PREFERRED_PROVIDER_virtual/kernel ?= "linux-nuvoton"

PREFERRED_VERSION_linux-nuvoton ?= "4.10.15"

PREFERRED_VERSION_u-boot ?= "v2015.10"
PREFERRED_VERSION_u-boot-fw-utils ?= "v2015.10"

KERNEL_IMAGETYPE ?= "uImage"
KERNEL_EXTRA_ARGS ?= "UIMAGE_LOADADDR=0x00008000"

UBOOT_ENTRYPOINT ?= "0x40008000"
UBOOT_LOADADDRESS ?= "0x40008000"
UBOOT_MACHINE ?= "PolegSVB_config"

SERIAL_CONSOLES = "115200;ttyS3"
```

## meta-nuvoton/meta-npcm750/conf/machine/include/tune-nuvoton.inc
```bitbake
DEFAULTTUNE ?= "npcm750"

require conf/machine/include/arm/arch-armv7a.inc

TUNEVALID[npcm750] = "Enable npcm750 specific processor optimizations"
#TUNE_CCARGS .= "${@bb.utils.contains("TUNE_FEATURES", "npcm750", " -mtune=arm7", "", d)}"
#cortexA9
#Need to find out what is the -mtune parameter

AVAILTUNES += "npcm750"
ARMPKGARCH_tune-npcm750 = "armv7a"
TUNE_FEATURES_tune-armv7a = "arm armv7a"
TUNE_FEATURES_tune-npcm750 = "${TUNE_FEATURES_tune-armv7a} npcm750"
PACKAGE_EXTRA_ARCHS_tune-npcm750 = "${PACKAGE_EXTRA_ARCHS_tune-armv7a}"
```

## meta-openbmc-machines/meta-evb/meta-evb-nuvoton/meta-evb-npcm750/conf/machine/evb-npcm750.conf
```bitbake
KMACHINE = "nuvoton"
KERNEL_DEVICETREE = "npcm750.dtb"

UBOOT_MACHINE = "PolegSVB_config"

FLASH_SIZE = "32768"

require conf/machine/include/npcm750.inc
require conf/machine/include/obmc-bsp-common.inc
```
